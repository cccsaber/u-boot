## arch/arm/mach-rockchip/rk3528/Kconfig
```kconfig
if ROCKCHIP_RK3528

config TARGET_EVB_RK3528
	bool "EVB_RK3528"
	select BOARD_LATE_INIT
	help
	  RK3528 EVB is a evaluation board for Rockchp RK3528.

config TARGET_H20PLUS
	bool "H20PLUS"
	select BOARD_LATE_INIT
	help
	  H20Plus is a RK3528 based board.

config SYS_SOC
	default "rockchip"

config SYS_MALLOC_F_LEN
	default 0x400

source board/rockchip/evb_rk3528/Kconfig
source board/rockchip/h20plus/Kconfig

endif
```

## board/rockchip/h20plus/Kconfig
```kconfig
if TARGET_H20PLUS

config SYS_BOARD
	default "h20plus"

config SYS_VENDOR
	default "rockchip"

config SYS_CONFIG_NAME
	default "h20plus"

config BOARD_SPECIFIC_OPTIONS
	def_bool y

config H20PLUS_FIT_ATF1_OVERRIDE
	string
	default "board/rockchip/h20plus/firmware/bl31_0x00080000.bin"
	help
	  Board-specific ATF-1 binary used only when packing uboot.img for
	  H20Plus. This keeps the H20Plus U-Boot DTB while overriding the
	  first BL31 payload with the known-good board-compatible build.

endif
```
